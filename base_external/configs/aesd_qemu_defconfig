## base_external/configs/aesd_qemu_defconfig
```kconfig
BR2_x86_i686=y
BR2_KERNEL_HEADERS_5_15=y
BR2_LINUX_KERNEL=y
BR2_LINUX_KERNEL_DEFCONFIG="x86_64"
BR2_TARGET_ROOTFS_EXT2=y
BR2_PACKAGE_AESD_ASSIGNMENTS=y
```
